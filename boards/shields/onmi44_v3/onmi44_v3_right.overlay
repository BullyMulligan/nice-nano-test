/*
 * Onmi44 v3 right half - BLE peripheral, forwards its stick to the central.
 */

#include "onmi44_v3.dtsi"

// Left half has 6 columns (0..5), so local columns map to 6..11.
&default_transform {
    col-offset = <6>;
};

/ {
    // Container with #size-cells = <0> so that reg = <index> is parsed as a
    // single-cell address (the root node uses #address-cells = 1 / #size-cells = 1).
    analog_stick_splits {
        #address-cells = <1>;
        #size-cells = <0>;

        analog_stick_split0: analog_stick_split@0 {
            compatible = "zmk,analog-stick-split";
            device = <&analog_stick0>;
            reg = <0>;
        };
    };
};
