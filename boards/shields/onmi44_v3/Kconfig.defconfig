## boards/shields/onmi44_v3/Kconfig.defconfig
```kconfig
if SHIELD_ONMI44_V3_LEFT

config ZMK_KEYBOARD_NAME
    default "Onmi44 v3"

config ZMK_SPLIT_ROLE_CENTRAL
    default y

endif

if SHIELD_ONMI44_V3_LEFT || SHIELD_ONMI44_V3_RIGHT

config ZMK_SPLIT
    default y

endif
```

## boards/shields/onmi44_v3/Kconfig.shield
```kconfig
config SHIELD_ONMI44_V3_LEFT
    def_bool $(shields_list_contains,onmi44_v3_left)

config SHIELD_ONMI44_V3_RIGHT
    def_bool $(shields_list_contains,onmi44_v3_right)
```

## config/west.yml
```yaml
manifest:
  remotes:
    - name: zmkfirmware
      url-base: https://github.com/zmkfirmware
    - name: bullymulligan
      url-base: https://github.com/BullyMulligan
  projects:
    - name: zmk
      remote: zmkfirmware
      revision: main
      import: app/west.yml
    - name: zmk-driver-analog-stick
      remote: bullymulligan
      revision: main
  self:
    path: config
```
