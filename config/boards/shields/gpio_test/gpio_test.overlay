/ {
	chosen {
		zmk,kscan = &kscan0;
	};

	kscan0: kscan {
		compatible = "zmk,kscan-gpio-direct";
		input-gpios
			= <&gpio1 5 (GPIO_ACTIVE_LOW | GPIO_PULL_UP)>
			, <&gpio1 6 (GPIO_ACTIVE_LOW | GPIO_PULL_UP)>
			, <&gpio1 7 (GPIO_ACTIVE_LOW | GPIO_PULL_UP)>
			, <&gpio1 8 (GPIO_ACTIVE_LOW | GPIO_PULL_UP)>
			;
	};
};